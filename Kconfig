## Kconfig
```kconfig
mainmenu "MKRTOS Project Configuration"
source "mkrtos_knl/Kconfig"
source "mkrtos_user/Kconfig"

config BOARD_NAME
    string "board name."
    default "stm32f103zet6"

config CPU_TYPE
    string "mkrtos set cpu type."
    default "stm32f1"

config ARCH
    string "cpu arch"
    default "cortex-m3"

config FLOAT_TYPE
    string "float type is soft or hard"
    default "soft"

config ELF_LAUNCH
    bool "elf app launch"
    default n

config DTBO_SUPPORT
    bool "dtb support."
    default n

config DTBO_OFFSET
    hex "dtbo img offset."
    default 0x1000

config CPIO_SUPPORT
    bool "support cpio img."
    default y

config APP_PARAMS_NR
    int "app params nr"
    default 8

config APP_ENV_NR
    int "app env nr"
    default 8
```

## mkrtos_configs/ATSURFF437_defconfig
```kconfig
#
# Knl config
#
CONFIG_KNL_INFO=y
CONFIG_SYS_TEXT_ADDR=0x8000000
CONFIG_SYS_TEXT_SIZE=0x3F0000
CONFIG_SYS_DATA_ADDR=0x20000000
CONFIG_SYS_DATA_SIZE=0x60000
CONFIG_BOOTSTRAP_TEXT_SIZE=0x3000
CONFIG_DTBO_TEXT_SIZE=0x1000
CONFIG_KNL_TEXT_SIZE=0x30000

CONFIG_MPU=y
CONFIG_FT_ADDR_NR=16
CONFIG_SYS_SCHE_HZ=1000
CONFIG_USER_ISR_START_NO=16
CONFIG_IRQ_REG_TAB_SIZE=80
CONFIG_REGION_NUM=8
CONFIG_OBJ_MAP_TAB_SIZE=32
CONFIG_OBJ_MAP_ENTRY_SIZE=32
CONFIG_PRINTK_CACHE_SIZE=128
# end of Knl config

#
# Libc backend
#
CONFIG_FD_MAP_ROW_CN=16
CONFIG_FD_MAP_ROW_NR=16
# end of Libc backend

#
# Sys util config
#
CONFIG_USING_SIG=y
CONFIG_SIG_THREAD_STACK_SIZE=512
CONFIG_SIG_THREAD_PRIO=3
# end of Sys util config


CONFIG_CPU_TYPE="at32f437"
CONFIG_ARCH="cortex-m4"
CONFIG_FLOAT_TYPE="soft"
CONFIG_BOARD_NAME="ATSURFF437"
CONFIG_BUDDY_SLAB=n
CONFIG_SMP=n
CONFIG_CPU=1
CONFIG_THREAD_BLOCK_SIZE=0x800
CONFIG_PAGE_SHIFT=9
CONFIG_MMU=n
CONFIG_KNL_TEST=n
CONFIG_ELF_LAUNCH=n
CONFIG_THREAD_MSG_BUG_LEN=128
CONFIG_THREAD_IPC_MSG_LEN=24
CONFIG_THREAD_MAP_BUF_LEN=4
CONFIG_THREAD_USER_BUF_LEN=4
CONFIG_MSG_BUF_VADDR=0xE0000000
CONFIG_BOOT_FS_VADDR=0xE0001000
CONFIG_MPU_PAGE_FAULT_SUPPORT=y
CONFIG_MPU_PAGE_FAULT_REGIONS_NUM=2
CONFIG_BOOT_INFO_SUPPORT=y
CONFIG_DTBO_SUPPORT=y
CONFIG_CPIO_SUPPORT=n
CONFIG_APP_PARAMS_NR=16
```

## mkrtos_configs/aarch64_qemu_defconfig
```kconfig
#
# Knl config
#
CONFIG_KNL_INFO=y
CONFIG_KNL_TEXT_ADDR=0x1000
CONFIG_KNL_TEXT_SIZE=0x100000
CONFIG_KNL_DATA_ADDR=0x40000000
CONFIG_KNL_DATA_SIZE=0x800000
CONFIG_KNL_OFFSET=0x1000
CONFIG_INIT_TASK_OFFSET=0x10000
CONFIG_BOOTFS_OFFSET=0x02000000
CONFIG_MK_MPU_CFG=n
CONFIG_FT_ADDR_NR=16
CONFIG_SYS_SCHE_HZ=100
CONFIG_USER_ISR_START_NO=16
CONFIG_IRQ_REG_TAB_SIZE=80
CONFIG_REGION_NUM=8
CONFIG_OBJ_MAP_TAB_SIZE=32
CONFIG_OBJ_MAP_ENTRY_SIZE=32
CONFIG_PRINTK_CACHE_SIZE=128
# end of Knl config

#
# Libc backend
#
CONFIG_FD_MAP_ROW_CN=16
CONFIG_FD_MAP_ROW_NR=16
# end of Libc backend

#
# Sys util config
#
CONFIG_USING_SIG=n
CONFIG_SIG_THREAD_STACK_SIZE=512
CONFIG_SIG_THREAD_PRIO=3
# end of Sys util config

#
# DFS: device virtual file system
#
CONFIG_RT_USING_DFS=y
CONFIG_DFS_USING_POSIX=y
CONFIG_DFS_USING_WORKDIR=y
# CONFIG_RT_USING_DFS_MNTTABLE is not set
CONFIG_DFS_FD_MAX=16
CONFIG_RT_USING_DFS_V1=y
# CONFIG_RT_USING_DFS_V2 is not set
CONFIG_DFS_FILESYSTEMS_MAX=4
CONFIG_DFS_FILESYSTEM_TYPES_MAX=4
# CONFIG_RT_USING_DFS_ELMFAT is not set
CONFIG_RT_USING_DFS_DEVFS=y
# CONFIG_RT_USING_DFS_ROMFS is not set
# CONFIG_RT_USING_DFS_CROMFS is not set
# CONFIG_RT_USING_DFS_RAMFS is not set
# CONFIG_RT_USING_DFS_TMPFS is not set
# CONFIG_RT_USING_DFS_MQUEUE is not set
# end of DFS: device virtual file system

#
# Device Drivers
#
# CONFIG_RT_USING_DM is not set
CONFIG_RT_USING_DEVICE_IPC=y
CONFIG_RT_UNAMED_PIPE_NUMBER=64
# CONFIG_RT_USING_SYSTEM_WORKQUEUE is not set
CONFIG_RT_USING_SERIAL=y
CONFIG_RT_USING_SERIAL_V1=y
# CONFIG_RT_USING_SERIAL_V2 is not set
CONFIG_RT_SERIAL_USING_DMA=y
CONFIG_RT_SERIAL_RB_BUFSZ=64
# CONFIG_RT_USING_CAN is not set
# CONFIG_RT_USING_HWTIMER is not set
# CONFIG_RT_USING_CPUTIME is not set
# CONFIG_RT_USING_I2C is not set
# CONFIG_RT_USING_PHY is not set
CONFIG_RT_USING_PIN=y
# CONFIG_RT_USING_ADC is not set
# CONFIG_RT_USING_DAC is not set
# CONFIG_RT_USING_NULL is not set
# CONFIG_RT_USING_ZERO is not set
# CONFIG_RT_USING_RANDOM is not set
# CONFIG_RT_USING_PWM is not set
# CONFIG_RT_USING_MTD_NOR is not set
# CONFIG_RT_USING_MTD_NAND is not set
# CONFIG_RT_USING_PM is not set
# CONFIG_RT_USING_RTC is not set
# CONFIG_RT_USING_SDIO is not set
# CONFIG_RT_USING_SPI is not set
# CONFIG_RT_USING_WDT is not set
# CONFIG_RT_USING_AUDIO is not set
# CONFIG_RT_USING_SENSOR is not set
# CONFIG_RT_USING_TOUCH is not set
# CONFIG_RT_USING_LCD is not set
# CONFIG_RT_USING_HWCRYPTO is not set
# CONFIG_RT_USING_PULSE_ENCODER is not set
# CONFIG_RT_USING_INPUT_CAPTURE is not set
# CONFIG_RT_USING_DEV_BUS is not set
# CONFIG_RT_USING_WIFI is not set
# CONFIG_RT_USING_VIRTIO is not set

#
# Using USB
#
# CONFIG_RT_USING_USB_HOST is not set
# CONFIG_RT_USING_USB_DEVICE is not set
# end of Using USB
# end of Device Drivers

CONFIG_CPU_TYPE="aarch64_qemu"
CONFIG_RTT_DIR="./"
CONFIG_ARCH="aarch64"
CONFIG_BOARD_NAME="aarch64_qemu"
CONFIG_BUDDY_SLAB=y
CONFIG_SMP=y
CONFIG_CPU=4
CONFIG_THREAD_BLOCK_SIZE=0x1000
CONFIG_PAGE_SHIFT=12
CONFIG_MMU=y
CONFIG_KNL_TEST=y
```

## mkrtos_knl/Kconfig
```kconfig
menu "Knl config"


menuconfig KNL_INFO
    bool "knl info set"
    default y

    config KNL_TEST
    bool "enable knl test."
    default n
if KNL_INFO
    config MMU
        bool "support mmu"
        default n
if MMU
    config MSG_BUF_VADDR
        hex "msg buf vaddr in task."
        default 0xE0000000
    config BOOT_FS_VADDR
        hex "boot fs vaddr in init task."
        default 0xE0001000
endif
    config PAGE_SHIFT
        int "page shift"
        default 9
    config PSCI
        bool "support psci"
        default n
    config SMP
        bool "support smp."
        default n
    config CPU
        int "CPU Core number."
        default 1
    config THREAD_MSG_BUG_LEN
        int "thread msg buf size"
        default 128
    config THREAD_IPC_MSG_LEN
        int "thread ipc msg max size"
        default 96
    config THREAD_MAP_BUF_LEN
        int "thread ipc map buf max size."
        default 16
    config THREAD_USER_BUF_LEN
        int "thread user buf max size(words)."
        default 4
    config BUDDY_SLAB
        bool "use BUDDY & SLAB"
        default n
    config THREAD_BLOCK_SIZE
        hex  "kthread block size"
        default 0x400
    config SYS_TEXT_ADDR
        hex  "The first address of the kernel text section"
        default 0x8000000

    config SYS_TEXT_SIZE
        hex "Size of the kernel text segment."
        default 0x100000
    
    config SYS_DATA_ADDR
        hex "knl data addr."
        default 0x20000000
    
    config SYS_DATA_SIZE
        hex "knl data size."
        default 0x2000000

    config BOOTSTRAP_TEXT_SIZE
        hex "bootstrap text size."
        default 0x2000

    config DTBO_TEXT_SIZE
        hex "dtbo text size."
        default 0x1000

    config KNL_TEXT_SIZE
        hex "knl text size."
        default 0x10000


menuconfig MPU
    bool "MKRTOS MPU config"
    default n
    if MPU
        config MPU_VERSION
        int "mpu version"
        default 1
        config MPU_PAGE_FAULT_SUPPORT
        bool "mpu page falut sim support."
        default 0
        config MPU_PAGE_FAULT_REGIONS_NUM
        int "mpu page fualt regions num."
        default 2
    endif
endif

config VCPU
    bool "enable vcpu support"
    default n
    help 
        enable thread vcpu support.

config FT_ADDR_NR
    int "The number of addresses supported by futex."
    default 16
    help
       Set the number of supported futex, which usually indicates how many user state locks are supported..
config SYS_SCHE_HZ
    int "System time slice size"
    default 1000
    help
        Set the time slice size of the system.

config USER_ISR_START_NO
    int "The starting point of the user mode interrupt number."
    default 16
    help
        This number indicates which interrupt number can be used for user status.
config IRQ_REG_TAB_SIZE
    int "The size of the interrupt registry in the kernel."
    default 80
    help 
        The interruption of user registration will temporarily use this table.
config REGION_NUM
    int "Number of MPU regions"
    default 8
    help 
        Set the number of regions protected by MPU.

config OBJ_MAP_TAB_SIZE
    int "The number of obj mapping tables."
    default 4
    help
        OBJ_MAP_TAB_SIZE * OBJ_MAP_ENTRY_SIZE is equal to the number of kernel objects that a task can map.
config OBJ_MAP_ENTRY_SIZE
    int "The size of the entries in the mapping table."
    default 8
    help
        OBJ_MAP_TAB_SIZE * OBJ_MAP_ENTRY_SIZE is equal to the number of kernel objects that a task can map.
config PRINTK_CACHE_SIZE
    int "The cache size of printk."
    default 128
    help
        The printk cache size refers to the size of the data content output to the console in a single attempt, which usually does not need to be modified.

config BOOT_INFO_SUPPORT
    bool "boot info support"
    default n
    help
        support boot info.

endmenu
```

## mkrtos_user/lib/Kconfig
```kconfig
source "mkrtos_user/lib/libc_backend/Kconfig"
source "mkrtos_user/lib/sys_util/Kconfig"
```

## mkrtos_user/lib/libc_backend/Kconfig
```kconfig
menu "Libc backend"

config FD_MAP_ROW_CN
    int "fd map row cn"
    default 16
    help
        Set the number of mapping layers, the larger the number of FD available to the user.
config FD_MAP_ROW_NR
    int "fd map row nr"
    default 16
    help
        Set the number of mapping layers, the larger the number of FD available to the user.
endmenu
```

## mkrtos_user/lib/sys_util/Kconfig
```kconfig
menu "Sys util config"

menuconfig USING_SIG
    bool "Using signal."
    default y
if USING_SIG
config SIG_THREAD_STACK_SIZE
    int  "Set signal thread stack size."
    default 512
config SIG_THREAD_PRIO
    int  "Set signal thread prio."
    default 3
endif
endmenu
```

## mkrtos_user/server/drv/rtthread_drv/Kconfig
```kconfig
source "mkrtos_user/server/drv/rtthread_drv/components/dfs/Kconfig"
source "mkrtos_user/server/drv/rtthread_drv/components/drivers/Kconfig"
```
