/dts-v1/;
/ {
	usart0:usart_0 {
		compatible = "st,usart";
		regs = <0x0000000 0x1000>;
		baud = <115200>;
		stopbits = <1>;
	};
	log {
		dev = <&usart0>;
	};
	pin {
		compatible = "at32f43x,pin";
		regs = <
		0x40020000 0x2000 /*GPIO*/
		0x40013800 0x400  /*EXINT & SCFG*/
		0x40013C00 0x400  /*EXINT & SCFG*/
		>;
	};
};
